## CMakeLists.txt
```
# Copyright (c) 2025 SILA Embedded Solutions GmbH
#
# SPDX-License-Identifier: Apache-2.0

cmake_minimum_required(VERSION 3.20.0)

find_package(Zephyr REQUIRED HINTS $ENV{ZEPHYR_BASE})
project(rtio_memory_chunks)

FILE(GLOB app_sources src/*.c)
target_sources(app PRIVATE ${app_sources})
```

## sample.yaml
```
sample:
  name: RTIO sample
tests:
  sample.rtio.memory_chunks:
    tags: rtio
    integration_platforms:
      - native_sim
    harness: console
    harness_config:
      type: multi_line
      regex:
        - "(.*)Submitting (.*) read requests"
        - "(.*)Start processing (.*) samples"
        - "(.*)Finished processing (.*) samples"
```

## prj.conf
```kconfig
CONFIG_LOG=y
CONFIG_LOG_MODE_MINIMAL=y
CONFIG_RTIO=y
```

## app.overlay
```dts
/*
 * Copyright (c) 2025 SILA Embedded Solutions GmbH
 *
 * SPDX-License-Identifier: Apache-2.0
 */

/ {
	dummy: dummy {
		compatible = "vnd,dummy-driver";
		status = "okay";
	};
};
```

## src/main.c
```c
/*
 * Copyright (c) 2025 SILA Embedded Solutions GmbH
 *
 * SPDX-License-Identifier: Apache-2.0
 */

#include <zephyr/kernel.h>
#include <zephyr/rtio/rtio.h>
#include <zephyr/logging/log.h>

LOG_MODULE_REGISTER(main, LOG_LEVEL_DBG);

int main(void)
{
	return 0;
}
```

## src/dummy_device.c
```c
/*
 * Copyright (c) 2025 SILA Embedded Solutions GmbH
 *
 * SPDX-License-Identifier: Apache-2.0
 */

#include <zephyr/rtio/rtio.h>
#include "dummy_device.h"

const struct rtio_iodev_api dummy_device_iodev_api = {
        .submit = dummy_device_iodev_submit,
};
```

## src/dummy_device.h
```c
/*
 * Copyright (c) 2025 SILA Embedded Solutions GmbH
 * SPDX-License-Identifier: Apache-2.0
 */
#ifndef _DUMMY_DEVICE_H_
#define _DUMMY_DEVICE_H_

#include <stddef.h>
#include <stdint.h>
#include <zephyr/device.h>
#include <zephyr/rtio/rtio.h>

/*
 * These defines would for normal devices reside in include/zephyr/rtio/rtio.h,
 * but for the purpose of this sample I do not want to pollute this header.
 */
#define RTIO_IODEV_DUMMY_DEVICE_START BIT(1)
#define RTIO_IODEV_DUMMY_DEVICE_STOP BIT(2)

typedef void (*dummy_device_api_iodev_submit)(const struct device *dev,
				     struct rtio_iodev_sqe *iodev_sqe);

__subsystem struct dummy_device_driver_api {
        dummy_device_api_iodev_submit iodev_submit;
};

static inline void dummy_device_iodev_submit(struct rtio_iodev_sqe *iodev_sqe)
{
	const struct device *dev = (const struct device *)iodev_sqe->sqe.iodev->data;
	const struct dummy_device_driver_api *api = (const struct dummy_device_driver_api *)dev->api;

        if (api->iodev_submit == NULL) {
		rtio_iodev_sqe_err(iodev_sqe, -ENOSYS);
		return;
	}
	api->iodev_submit(dev, iodev_sqe);
}

extern const struct rtio_iodev_api dummy_device_iodev_api;

#define DUMMY_DEVICE_IODEV_DEFINE(name, dev)                                     \
	RTIO_IODEV_DEFINE(name, &dummy_device_iodev_api, (void *)DEVICE_DT_GET(dev))

#endif /* _DUMMY_DEVICE_H_ */
```

## src/dummy_driver.c
```c
/*
 * Copyright (c) 2025 SILA Embedded Solutions GmbH
 *
 * SPDX-License-Identifier: Apache-2.0
 */

#define DT_DRV_COMPAT vnd_dummy_driver

#include <zephyr/kernel.h>
#include <zephyr/rtio/rtio.h>
#include <zephyr/logging/log.h>
#include <zephyr/sys/util.h>
#include "dummy_device.h"

LOG_MODULE_REGISTER(dummy_driver, LOG_LEVEL_DBG);

struct dummy_driver_config {};

struct dummy_driver_data {};

static int dummy_driver_init(const struct device *dev)
{
        LOG_DBG("initializing dummy driver");
	return 0;
}

static void dummy_driver_iodev_submit(const struct device *dev, struct rtio_iodev_sqe *iodev_sqe)
{
	if (iodev_sqe->sqe.iodev_flags & RTIO_IODEV_DUMMY_DEVICE_START) {
		LOG_DBG("executing start procedure");
	}

	LOG_HEXDUMP_DBG(iodev_sqe->sqe.tx.buf, iodev_sqe->sqe.tx.buf_len, "writing data");

	if (iodev_sqe->sqe.iodev_flags & RTIO_IODEV_DUMMY_DEVICE_STOP) {
		LOG_DBG("executing stop procedure");
	}
}

static DEVICE_API(dummy_device, dummy_driver_api) = {
	.iodev_submit = dummy_driver_iodev_submit,
};

#define DUMMY_DRIVER_INIT(n)                                                                       \
                                                                                                   \
	static const struct dummy_driver_config dummy_driver_config_##n = { };                     \
                                                                                                   \
	static struct dummy_driver_data dummy_driver_data_##n = { };                               \
                                                                                                   \
	DEVICE_DT_INST_DEFINE(n, dummy_driver_init, NULL, &dummy_driver_data_##n,                  \
			      &dummy_driver_config_##n, POST_KERNEL,                               \
			      CONFIG_KERNEL_INIT_PRIORITY_DEVICE, NULL);

DT_INST_FOREACH_STATUS_OKAY(DUMMY_DRIVER_INIT)
```
